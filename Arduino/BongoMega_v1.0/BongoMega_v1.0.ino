/*
  BongoMega_v05.ino

  Hardware:
    Arduino Mega 2560
    Whadda WPSH412 TFT shield
    ILI9341 240x320
    MCUFRIEND_kbv
    Built-in SD card reader

  SD:
    Software SPI using SdFat 2.3.0
    CS   = 10
    MOSI = 11
    MISO = 12
    SCK  = 13

  SD structure:
    /FRAMES/IDLE1.RGB
    /FRAMES/IDLE2.RGB
    /FRAMES/IDLE3.RGB
    /FRAMES/SLEEP1.RGB
    /FRAMES/SLEEP2.RGB
    /FRAMES/SLEEP3.RGB
    /FRAMES/BLINK.RGB
    /FRAMES/EAR.RGB
    /FRAMES/TYPE_L.RGB
    /FRAMES/TYPE_UP.RGB
    /FRAMES/TYPE_R.RGB
    /FRAMES/FAST_L.RGB
    /FRAMES/FAST_UP.RGB
    /FRAMES/FAST_R.RGB
    /FRAMES/HAPPY_L.RGB
    /FRAMES/HAPPY_UP.RGB
    /FRAMES/HAPPY_R.RGB
    /FRAMES/PET1.RGB
    /FRAMES/PET2.RGB

  /DELTAS/00_01.DLT ... (generated by make_deltas.py)

  Frame format:
    64x64 RGB565
    Little-endian
    8192 bytes per frame

  Serial:
    115200 baud

    SPEED:<number>
    STOP
    IDLE_START
    IDLE
    HEARTBEAT
    STREAK_ON
    STREAK_OFF
    PET:ON
    PET:OFF
    STATS:CPU:45,RAM:67,WPM:23
    ROTATION:<0|2>

  Touch:
    Top half of screen = toggle petting (rotation-aware)
*/

#include <SPI.h>
#include "SdFat.h"
#include <Adafruit_GFX.h>
#include <MCUFRIEND_kbv.h>
#include <string.h>
#include <stdlib.h>
#include <stdio.h>
#include <TouchScreen.h>

// --------------------------------------------------
// HARDWARE
// --------------------------------------------------

MCUFRIEND_kbv tft;

// TFT shield SD reader: native UNO shield pins.
static const uint8_t SD_CS = 10;
static const uint8_t SD_MISO = 12;
static const uint8_t SD_MOSI = 11;
static const uint8_t SD_SCK = 13;

// Software SPI driver.
SoftSpiDriver<SD_MISO, SD_MOSI, SD_SCK> softSpi;

#define SD_CONFIG SdSpiConfig(SD_CS, DEDICATED_SPI, SD_SCK_MHZ(0), &softSpi)

// SdFat filesystem.
SdFs sd;

// Touch screen (Whadda WPSH412 shield, Arduino Mega).
#define TOUCH_XP 8
#define TOUCH_YP A3
#define TOUCH_XM A2
#define TOUCH_YM 9
#define TOUCH_RX 100
#define TOUCH_MINPRESSURE 1
#define TOUCH_MAXPRESSURE 1000
#define TOUCH_MINX 120
#define TOUCH_MAXX 900
#define TOUCH_MINY 70
#define TOUCH_MAXY 920
TouchScreen touchScreen = TouchScreen(TOUCH_XP, TOUCH_YP, TOUCH_XM, TOUCH_YM, TOUCH_RX);

static const uint16_t SCREEN_W = 240;
static const uint16_t SCREEN_H = 320;

static const uint8_t SPRITE_SIZE = 64;
static const uint8_t SPRITE_SCALE = 3;

static const uint16_t SPRITE_X = 24;
static const uint16_t SPRITE_Y = 91;

static const uint16_t SPRITE_W = SPRITE_SIZE * SPRITE_SCALE;
static const uint16_t SPRITE_H = SPRITE_SIZE * SPRITE_SCALE;

static const uint32_t FRAME_BYTES = 8192UL;
static const uint8_t FRAME_COUNT = 19;

// Must match the order used by make_deltas.py.
const char * const FRAME_NAMES[FRAME_COUNT] = {
    "IDLE1", "IDLE2", "IDLE3",
    "SLEEP1", "SLEEP2", "SLEEP3",
    "BLINK", "EAR",
    "TYPE_L", "TYPE_UP", "TYPE_R",
    "FAST_L", "FAST_UP", "FAST_R",
    "HAPPY_L", "HAPPY_UP", "HAPPY_R",
    "PET1", "PET2"
};

// --------------------------------------------------
// COLORS
// --------------------------------------------------

#define C_BLACK   0x0000
#define C_WHITE   0xFFFF
#define C_GREY    0x8410
#define C_DARK    0x2104
#define C_ACCENT  0x07FF
#define C_GREEN   0x07E0
#define C_RED     0xF800
#define C_YELLOW  0xFFE0

// --------------------------------------------------
// SERIAL STATE
// --------------------------------------------------

char serialBuffer[100];
uint8_t serialPosition = 0;

int cpuUsage = -1;
int ramUsage = -1;
int wordsPerMinute = 0;

bool typing = false;
bool streak = false;
bool sleeping = false;
bool petting = false;
bool wasTouched = false;

uint32_t lastActivity = 0;
uint32_t lastHeartbeat = 0;
uint32_t lastAnimation = 0;
uint32_t lastBlink = 0;
uint32_t lastTouchRead = 0;
uint32_t lastPetRelease = 0;
bool wasTouchingTop = false;

uint32_t animationInterval = 180;

uint8_t typingStep = 0;
uint8_t sleepStep = 0;
uint8_t petStep = 0;

uint8_t tftRotation = 0;

bool blinkActive = false;

// --------------------------------------------------
// DISPLAY STATE
// --------------------------------------------------

char currentFrame[16] = "";
char currentMode[16] = "";

bool sdReady = false;
bool displayReady = false;

// True only when the TFT contents match currentFrame.
bool displayValid = false;

// --------------------------------------------------
// BUFFERS
// --------------------------------------------------

// One source row: 64 RGB565 pixels = 128 bytes.
uint8_t sourceRow[SPRITE_SIZE * 2];

// One enlarged output row: 192 RGB565 pixels.
uint16_t outputRow[SPRITE_W];

// --------------------------------------------------
// FORWARD DECLARATIONS
// --------------------------------------------------

void drawStaticUI();
void drawStats();
void drawMode(const char *mode);
void drawSDStatus(bool ok);

void drawCenteredText(
    const char *text,
    int16_t y,
    uint8_t size,
    uint16_t color
);

bool loadFrame(const char *name);
void setFrame(const char *name);

void processSerial();
void processCommand(char *command);

void updateAnimation();

void enterTyping();
void enterIdle();
void enterSleep();
void enterPet();
void exitPet();

// --------------------------------------------------
// SETUP
// --------------------------------------------------

void setup() {
    Serial.begin(115200);

    lastActivity = millis();
    lastHeartbeat = millis();
    lastAnimation = millis();

    // Initialize TFT.
    uint16_t driverID = tft.readID();

    if (driverID == 0xD3D3 ||
        driverID == 0x0000 ||
        driverID == 0xFFFF) {
        driverID = 0x9341;
    }

    tft.begin(driverID);
    tft.setRotation(tftRotation);

    displayReady = true;

    drawStaticUI();

    // ------------------------------------------------
    // INITIALIZE SD USING SOFTWARE SPI
    // ------------------------------------------------

    pinMode(53, OUTPUT);
    digitalWrite(53, HIGH);

    pinMode(SD_CS, OUTPUT);
    digitalWrite(SD_CS, HIGH);

    sdReady = sd.begin(SD_CONFIG);

    drawSDStatus(sdReady);

    if (sdReady) {
        drawMode("INITIALIZING");
        setFrame("IDLE1");
    } else {
        drawMode("SD ERROR");

        drawCenteredText(
            "CHECK SD CARD",
            155,
            2,
            C_RED
        );

        Serial.println(F("SD INITIALIZATION FAILED"));

        sd.printSdError(&Serial);
    }

    drawStats();

    Serial.println(F("BONGO_MEGA_READY"));
    Serial.println(F("Display initialized"));

    Serial.print(F("TFT ID: 0x"));
    Serial.println(driverID, HEX);

    Serial.print(F("SD: "));
    Serial.println(sdReady ? F("OK") : F("FAILED"));
}

// --------------------------------------------------
// MAIN LOOP
// --------------------------------------------------

void loop() {
    processSerial();

    // ----------------------------------------------
    // TOUCH DETECTION
    // ----------------------------------------------

    uint32_t now = millis();
    if (now - lastTouchRead >= 50UL) {
        lastTouchRead = now;

        TSPoint p = touchScreen.getPoint();

        // Restore TFT control pins after getPoint() (library leaves them INPUT).
        pinMode(TOUCH_XM, OUTPUT);
        pinMode(TOUCH_YP, OUTPUT);

        bool touched = (p.z > TOUCH_MINPRESSURE && p.z < TOUCH_MAXPRESSURE);

        // Detect touch press / release edges.
        bool justPressed = touched && !wasTouched;
        bool justReleased = !touched && wasTouched;
        wasTouched = touched;

        if (justPressed) {
            // Map raw touch to screen pixels (axes swapped, like working example).
            int16_t px = map(p.y, TOUCH_MAXY, TOUCH_MINY, 0, SCREEN_W);
            int16_t py = map(p.x, TOUCH_MAXX, TOUCH_MINX, 0, SCREEN_H);

            // Adjust Y for rotation so "top half" is always physical top.
            uint16_t physicalY;
            if (tftRotation == 2) {
                physicalY = SCREEN_H - 1 - (uint16_t)py;
            } else {
                physicalY = (uint16_t)py;
            }

            Serial.print(F("TOUCH px="));
            Serial.print(px);
            Serial.print(F(" py="));
            Serial.print(py);
            Serial.print(F(" physicalY="));
            Serial.println(physicalY);

            // Top half touch starts petting.
            if (!petting && physicalY < SCREEN_H / 2) {
                enterPet();
            }
        }

        if (justReleased) {
            lastPetRelease = millis();
        }

        // Exit PET only if finger has been released for >500ms (debounce).
        if (petting && !touched && millis() - lastPetRelease > 500UL) {
            exitPet();
        }
    }

    if (sdReady) {
        updateAnimation();
    }

    // Return to idle after typing stops.
    if (typing && millis() - lastActivity > 5000UL) {
        enterIdle();
    }

    // Sleep after 60 seconds without activity.
    if (!typing && !streak && !sleeping && !petting &&
        millis() - lastActivity > 60000UL) {
        enterSleep();
    }
}

// --------------------------------------------------
// STATIC UI
// --------------------------------------------------

void drawStaticUI() {
    tft.fillScreen(C_BLACK);

    // Header.
    tft.setTextColor(C_ACCENT);
    tft.setTextSize(3);
    tft.setCursor(18, 12);
    tft.print(F("BONGO CAT"));

    tft.drawFastHLine(10, 52, 220, C_GREY);

    // Status heading.
    tft.setTextSize(1);
    tft.setTextColor(C_GREY);
    tft.setCursor(12, 63);
    tft.print(F("ANIMATION"));

    // Sprite background.
    tft.drawRect(18, 87, 204, 200, C_DARK);

    // Statistics section.
    tft.drawFastHLine(10, 292, 220, C_GREY);

    tft.setTextSize(1);
    tft.setTextColor(C_GREY);

    tft.setCursor(12, 294);
    tft.print(F("CPU"));

    tft.setCursor(91, 294);
    tft.print(F("RAM"));

    tft.setCursor(169, 294);
    tft.print(F("WPM"));

    // Initial values.
    tft.setTextSize(2);
    tft.setTextColor(C_WHITE);

    tft.setCursor(12, 303);
    tft.print(F("--"));

    tft.setCursor(91, 303);
    tft.print(F("--"));

    tft.setCursor(169, 303);
    tft.print(F("0"));

    // Mode field.
    tft.fillRect(12, 73, 216, 12, C_BLACK);
}

// --------------------------------------------------
// STATISTICS
// --------------------------------------------------

void drawStats() {
    char value[8];

    tft.setTextSize(2);
    tft.setTextColor(C_WHITE);

    // CPU.
    tft.fillRect(12, 303, 60, 17, C_BLACK);
    tft.setCursor(12, 303);

    if (cpuUsage < 0) {
        tft.print(F("--"));
    } else {
        snprintf(value, sizeof(value), "%d", cpuUsage);
        tft.print(value);
        tft.print('%');
    }

    // RAM.
    tft.fillRect(91, 303, 60, 17, C_BLACK);
    tft.setCursor(91, 303);

    if (ramUsage < 0) {
        tft.print(F("--"));
    } else {
        snprintf(value, sizeof(value), "%d", ramUsage);
        tft.print(value);
        tft.print('%');
    }

    // WPM.
    tft.fillRect(169, 303, 65, 17, C_BLACK);
    tft.setCursor(169, 303);

    snprintf(value, sizeof(value), "%d", wordsPerMinute);
    tft.print(value);
}

// --------------------------------------------------
// MODE DISPLAY
// --------------------------------------------------

void drawMode(const char *mode) {
    if (strcmp(currentMode, mode) == 0) {
        return;
    }

    strncpy(currentMode, mode, sizeof(currentMode) - 1);
    currentMode[sizeof(currentMode) - 1] = '\0';

    tft.fillRect(12, 73, 216, 12, C_BLACK);

    tft.setCursor(12, 73);
    tft.setTextSize(1);
    tft.setTextColor(C_ACCENT);
    tft.print(mode);
}

// --------------------------------------------------
// SD STATUS
// --------------------------------------------------

void drawSDStatus(bool ok) {
    tft.fillRect(160, 63, 68, 10, C_BLACK);

    tft.setTextSize(1);
    tft.setCursor(160, 63);

    if (ok) {
        tft.setTextColor(C_GREEN);
        tft.print(F("SD READY"));
    } else {
        tft.setTextColor(C_RED);
        tft.print(F("SD ERROR"));
    }
}

// --------------------------------------------------
// CENTERED TEXT
// --------------------------------------------------

void drawCenteredText(
    const char *text,
    int16_t y,
    uint8_t size,
    uint16_t color
) {
    int16_t x1, y1;
    uint16_t w, h;

    tft.setTextSize(size);

    tft.getTextBounds(
        text,
        0,
        y,
        &x1,
        &y1,
        &w,
        &h
    );

    int16_t x = (SCREEN_W - w) / 2;

    tft.setTextColor(color);
    tft.setCursor(x, y);
    tft.print(text);
}

// --------------------------------------------------
// SPRITE LOADING - SdFat SOFTWARE SPI
// --------------------------------------------------

int8_t getFrameId(const char *name) {
    for (uint8_t i = 0; i < FRAME_COUNT; i++) {
        if (strcmp(name, FRAME_NAMES[i]) == 0) return (int8_t)i;
    }
    return -1;
}

bool drawFullFrame(FsFile &frame) {
    if (frame.fileSize() != FRAME_BYTES) return false;

    tft.setAddrWindow(
        SPRITE_X, SPRITE_Y,
        SPRITE_X + SPRITE_W - 1,
        SPRITE_Y + SPRITE_H - 1
    );

    bool firstBlock = true;
    for (uint8_t y = 0; y < SPRITE_SIZE; y++) {
        if (frame.read(sourceRow, sizeof(sourceRow)) != sizeof(sourceRow)) {
            return false;
        }

        uint16_t outPosition = 0;
        for (uint8_t x = 0; x < SPRITE_SIZE; x++) {
            uint16_t color = (uint16_t)sourceRow[x * 2] |
                             ((uint16_t)sourceRow[x * 2 + 1] << 8);
            outputRow[outPosition++] = color;
            outputRow[outPosition++] = color;
            outputRow[outPosition++] = color;
        }

        for (uint8_t repeat = 0; repeat < SPRITE_SCALE; repeat++) {
            tft.pushColors(outputRow, SPRITE_W, firstBlock);
            firstBlock = false;
        }
    }
    return true;
}

bool drawDelta(FsFile &delta) {
    // Format: 64 records. Each record begins with startX,count.
    // count=0 means unchanged row and startX must be 255.
    bool anyDrawn = false;
    for (uint8_t y = 0; y < SPRITE_SIZE; y++) {
        uint8_t rowHeader[2];
        if (delta.read(rowHeader, 2) != 2) return false;

        uint8_t startX = rowHeader[0];
        uint8_t count = rowHeader[1];
        if (count == 0) {
            if (startX != 255) return false;
            continue;
        }
        if (startX >= SPRITE_SIZE || count > SPRITE_SIZE ||
            (uint16_t)startX + count > SPRITE_SIZE) return false;

        uint16_t bytes = (uint16_t)count * 2;
        if (delta.read(sourceRow, bytes) != bytes) return false;

        uint16_t outputStart = (uint16_t)startX * SPRITE_SCALE;
        uint16_t outputWidth = (uint16_t)count * SPRITE_SCALE;
        uint16_t outPosition = outputStart;

        for (uint8_t x = 0; x < count; x++) {
            uint16_t color = (uint16_t)sourceRow[x * 2] |
                             ((uint16_t)sourceRow[x * 2 + 1] << 8);
            outputRow[outPosition++] = color;
            outputRow[outPosition++] = color;
            outputRow[outPosition++] = color;
        }

        uint16_t screenX1 = SPRITE_X + outputStart;
        uint16_t screenX2 = screenX1 + outputWidth - 1;
        uint16_t screenY1 = SPRITE_Y + (uint16_t)y * SPRITE_SCALE;
        uint16_t screenY2 = screenY1 + SPRITE_SCALE - 1;

        tft.setAddrWindow(screenX1, screenY1, screenX2, screenY2);
        for (uint8_t repeat = 0; repeat < SPRITE_SCALE; repeat++) {
            tft.pushColors(&outputRow[outputStart], outputWidth, repeat == 0);
        }
        anyDrawn = true;
    }
    return anyDrawn;
}

bool loadFrame(const char *name) {
    if (!sdReady) return false;
    if (displayValid && strcmp(currentFrame, name) == 0) return true;

    char framePath[32];
    snprintf(framePath, sizeof(framePath), "/FRAMES/%s.RGB", name);

    FsFile frame;
    if (!frame.open(framePath, O_RDONLY)) {
        Serial.print(F("FRAME_OPEN_ERROR: "));
        Serial.println(framePath);
        displayValid = false;
        return false;
    }

    if (frame.fileSize() != FRAME_BYTES) {
        Serial.println(F("FRAME_SIZE_ERROR"));
        frame.close();
        displayValid = false;
        return false;
    }

    bool drawn = false;
    int8_t oldId = displayValid ? getFrameId(currentFrame) : -1;
    int8_t newId = getFrameId(name);

    // Use a precomputed transition when the display's current frame is known.
    if (oldId >= 0 && newId >= 0) {
        char deltaPath[24];
        snprintf(deltaPath, sizeof(deltaPath), "/DELTAS/%02d_%02d.DLT",
                 oldId, newId);

        FsFile delta;
        if (delta.open(deltaPath, O_RDONLY)) {
            uint32_t deltaSize = delta.fileSize();
            if (deltaSize >= 128UL && deltaSize < FRAME_BYTES) {
                drawn = drawDelta(delta);
            }
            delta.close();
            if (!drawn) {
                Serial.print(F("DELTA_INVALID_FALLBACK: "));
                Serial.println(deltaPath);
            }
        }
    }

    // Missing, oversized or invalid delta: load the full RGB frame.
    if (!drawn) {
        drawn = drawFullFrame(frame);
    }

    frame.close();
    if (!drawn) {
        Serial.println(F("FRAME_DRAW_ERROR"));
        displayValid = false;
        return false;
    }

    strncpy(currentFrame, name, sizeof(currentFrame) - 1);
    currentFrame[sizeof(currentFrame) - 1] = '\0';
    displayValid = true;
    return true;
}

// --------------------------------------------------
// SET FRAME
// --------------------------------------------------

void setFrame(const char *name) {
    if (displayValid && strcmp(currentFrame, name) == 0) {
        return;
    }

    if (!loadFrame(name)) {
        Serial.print(F("FRAME_ERROR: "));
        Serial.println(name);
    }
}

// --------------------------------------------------
// ANIMATION STATES
// --------------------------------------------------

void enterTyping() {
    if (!typing) {
        typingStep = 0;
    }

    typing = true;
    streak = false;
    sleeping = false;
    petting = false;

    lastActivity = millis();

    drawMode("TYPING");
}

void enterIdle() {
    typing = false;
    streak = false;
    sleeping = false;
    petting = false;

    blinkActive = false;

    lastActivity = millis();
    typingStep = 0;

    drawMode("IDLE");
    setFrame("IDLE1");
}

void enterSleep() {
    typing = false;
    streak = false;
    sleeping = true;
    petting = false;

    sleepStep = 0;

    drawMode("SLEEPING");
    setFrame("SLEEP1");

    lastAnimation = millis();
}

void enterPet() {
    petting = true;
    typing = false;
    streak = false;
    sleeping = false;
    petStep = 0;

    drawMode("PET");
    setFrame("PET1");

    lastAnimation = millis();
}

void exitPet() {
    petting = false;
    enterIdle();
}

// --------------------------------------------------
// ANIMATION UPDATE
// --------------------------------------------------

void updateAnimation() {
    uint32_t now = millis();

    // ----------------------------------------------
    // PET
    // ----------------------------------------------

    if (petting) {

        if (now - lastAnimation < animationInterval) {
            return;
        }

        lastAnimation = now;

        if (petStep == 0) {
            setFrame("PET1");
        } else {
            setFrame("PET2");
        }

        petStep = 1 - petStep;

        return;
    }

    // ----------------------------------------------
    // STREAK
    // ----------------------------------------------

    if (streak) {

        if (now - lastAnimation < animationInterval) {
            return;
        }

        lastAnimation = now;

        switch (typingStep) {

            case 0:
                setFrame("HAPPY_L");
                break;

            case 1:
                setFrame("HAPPY_UP");
                break;

            case 2:
                setFrame("HAPPY_R");
                break;

            default:
                setFrame("HAPPY_UP");
                break;
        }

        typingStep = (typingStep + 1) % 4;

        return;
    }

    // ----------------------------------------------
    // NORMAL TYPING
    // ----------------------------------------------

    if (typing) {

        if (now - lastAnimation < animationInterval) {
            return;
        }

        lastAnimation = now;

        bool fast = wordsPerMinute >= 70;

        switch (typingStep) {

            case 0:
                setFrame(fast ? "FAST_L" : "TYPE_L");
                break;

            case 1:
                setFrame(fast ? "FAST_UP" : "TYPE_UP");
                break;

            case 2:
                setFrame(fast ? "FAST_R" : "TYPE_R");
                break;

            default:
                setFrame(fast ? "FAST_UP" : "TYPE_UP");
                break;
        }

        typingStep = (typingStep + 1) % 4;

        return;
    }

    // ----------------------------------------------
    // SLEEPING
    // ----------------------------------------------

    if (sleeping) {

        if (now - lastAnimation < 900UL) {
            return;
        }

        lastAnimation = now;

        switch (sleepStep) {

            case 0:
                setFrame("SLEEP1");
                break;

            case 1:
                setFrame("SLEEP2");
                break;

            default:
                setFrame("SLEEP3");
                break;
        }

        sleepStep = (sleepStep + 1) % 3;

        return;
    }

    // ----------------------------------------------
    // IDLE / BLINK
    // ----------------------------------------------

    if (now - lastAnimation >= 2500UL) {

        lastAnimation = now;

        if (blinkActive) {
            blinkActive = false;
            setFrame("IDLE1");
        } else {
            blinkActive = true;
            setFrame("BLINK");
        }
    }

    // ----------------------------------------------
    // EAR TWITCH
    // ----------------------------------------------

    if (!blinkActive && now - lastBlink > 12000UL) {

        lastBlink = now;
        setFrame("EAR");
    }
}

// --------------------------------------------------
// SERIAL INPUT
// --------------------------------------------------

void processSerial() {

    while (Serial.available() > 0) {

        char c = Serial.read();

        if (c == '\r') {
            continue;
        }

        if (c == '\n') {

            serialBuffer[serialPosition] = '\0';

            if (serialPosition > 0) {
                processCommand(serialBuffer);
            }

            serialPosition = 0;

            continue;
        }

        if (serialPosition < sizeof(serialBuffer) - 1) {

            serialBuffer[serialPosition++] = c;

        } else {

            // Discard malformed/oversized command.
            serialPosition = 0;
        }
    }
}

// --------------------------------------------------
// SERIAL COMMAND PROCESSING
// --------------------------------------------------

void processCommand(char *command) {

    // ----------------------------------------------
    // SPEED:<number>
    // ----------------------------------------------

    if (strncmp(command, "SPEED:", 6) == 0) {

        int speed = atoi(command + 6);

        wordsPerMinute = speed;

        if (speed <= 0) {

            enterIdle();

        } else {

            animationInterval =
                220UL - (uint32_t)constrain(speed, 0, 140);

            animationInterval = max(70UL, animationInterval);

            enterTyping();
        }

        drawStats();

        return;
    }

    // ----------------------------------------------
    // STOP
    // ----------------------------------------------

    if (strcmp(command, "STOP") == 0) {

        enterIdle();

        return;
    }

    // ----------------------------------------------
    // IDLE
    // ----------------------------------------------

    if (strcmp(command, "IDLE_START") == 0 ||
        strcmp(command, "IDLE") == 0) {

        enterIdle();

        return;
    }

    // ----------------------------------------------
    // HEARTBEAT
    // ----------------------------------------------

    if (strcmp(command, "HEARTBEAT") == 0) {

        lastHeartbeat = millis();

        return;
    }

    // ----------------------------------------------
    // STREAK ON
    // ----------------------------------------------

    if (strcmp(command, "STREAK_ON") == 0) {

        streak = true;
        typing = false;
        sleeping = false;
        petting = false;

        typingStep = 0;

        lastActivity = millis();

        drawMode("STREAK");

        return;
    }

    // ----------------------------------------------
    // PET ON / PET OFF
    // ----------------------------------------------

    if (strcmp(command, "PET:ON") == 0) {

        enterPet();

        return;
    }

    if (strcmp(command, "PET:OFF") == 0) {

        exitPet();

        return;
    }

    // ----------------------------------------------
    // STREAK OFF
    // ----------------------------------------------

    if (strcmp(command, "STREAK_OFF") == 0) {

        streak = false;

        enterIdle();

        return;
    }

    // ----------------------------------------------
    // ROTATION:<0|2>
    // ----------------------------------------------

    if (strncmp(command, "ROTATION:", 9) == 0) {

        int rot = atoi(command + 9);

        if (rot == 2) {
            tftRotation = 2;
        } else {
            tftRotation = 0;
        }

        tft.setRotation(tftRotation);
        drawStaticUI();
        drawStats();
        drawMode(currentMode);

        if (sdReady) {
            char lastFrame[16];
            strncpy(lastFrame, currentFrame, sizeof(lastFrame) - 1);
            lastFrame[sizeof(lastFrame) - 1] = '\0';
            displayValid = false;
            currentFrame[0] = '\0';
            if (lastFrame[0] != '\0') {
                setFrame(lastFrame);
            } else {
                setFrame("IDLE1");
            }
        }

        return;
    }

    // ----------------------------------------------
    // STATS:CPU:45,RAM:67,WPM:23
    // ----------------------------------------------

    if (strncmp(command, "STATS:", 6) == 0) {

        int cpu = -1;
        int ram = -1;
        int wpm = 0;

        int parsed = sscanf(
            command,
            "STATS:CPU:%d,RAM:%d,WPM:%d",
            &cpu,
            &ram,
            &wpm
        );

        if (parsed == 3) {

            cpuUsage = constrain(cpu, 0, 100);
            ramUsage = constrain(ram, 0, 100);
            wordsPerMinute = max(0, wpm);

            drawStats();

            if (typing || wordsPerMinute > 0) {
                lastActivity = millis();
            }
        }

        return;
    }

    // ----------------------------------------------
    // UNKNOWN COMMAND
    // ----------------------------------------------

    Serial.print(F("UNKNOWN_COMMAND: "));
    Serial.println(command);
}
